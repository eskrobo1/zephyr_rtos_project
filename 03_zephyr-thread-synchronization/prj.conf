## CMakeLists.txt
```
cmake_minimum_required(VERSION 3.20.0)
find_package(Zephyr REQUIRED HINTS $ENV{ZEPHYR_BASE})
project(mutex_semafor_demo)

target_sources(app PRIVATE
    src/main.c
    src/mutex_lcd.c
    src/sem_sensor.c
    src/shared_data.c
)

target_include_directories(app PRIVATE src)
```

## prj.conf
```kconfig
# Kernel configuration
CONFIG_MAIN_STACK_SIZE=1024
CONFIG_HEAP_MEM_POOL_SIZE=1024

# Thread configuration
CONFIG_NUM_PREEMPT_PRIORITIES=16

# Timing
CONFIG_SYSTEM_WORKQUEUE_STACK_SIZE=1024

# Debugging options (optional)
CONFIG_DEBUG=y
CONFIG_THREAD_MONITOR=y
CONFIG_THREAD_NAME=y
CONFIG_THREAD_STACK_INFO=y

# Random number generator
CONFIG_TEST_RANDOM_GENERATOR=y

# Enable printk
CONFIG_PRINTK=y

# Enable C library
CONFIG_MINIMAL_LIBC=y
```

## src/main.c
```c
#include <zephyr/kernel.h>
#include <zephyr/sys/printk.h>
#include "shared_data.h"

/* Deklaracije funkcija iz drugih fajlova */
extern void mutex_lcd_init(void);
extern void sem_sensor_init(void);

int main(void) {
    printk("\n\n========================================\n");
    printk("    ZEPHYR MUTEX I SEMAFOR DEMO\n");
    printk("========================================\n");
    printk("MUTEX: 3 niti dijele LCD (2s, 3s, 4s)\n");
    printk("SEMAFOR: ISR->Worker komunikacija (800ms)\n");
    printk("LCD prikazuje STVARNE senzor vrijednosti!\n");
    printk("========================================\n\n");
    
    sensor_data_init();
    mutex_lcd_init();
    sem_sensor_init();
    
    printk("Svi taskovi pokrenuti!\n");
    printk("========================================\n\n");
    
    return 0;
}
```

## src/mutex_lcd.c
```c
#include <zephyr/kernel.h>
#include <zephyr/sys/printk.h>
#include <zephyr/random/random.h>
#include <string.h>
#include "shared_data.h"

#define LCD_STACK_SIZE 1024
#define LCD_PRIORITY 5

K_MUTEX_DEFINE(lcd_mutex);

static void lcd_print(const char *message) {
    uint32_t uptime = k_uptime_get_32();
    printk("[%6d.%03d] [MUTEX-LCD] ========== %s ==========\n", 
           uptime/1000, uptime%1000, message);
    k_sleep(K_MSEC(500));
}

static const char* get_system_status(void) {
    static const char* statuses[] = {"OK", "WARNING", "LOW BATTERY", "UPDATING"};
    return statuses[sys_rand32_get() % 4];
}

static void temperature_display_thread(void *p1, void *p2, void *p3) {
    char display_buffer[32];
    
    while(1) {
        k_mutex_lock(&lcd_mutex, K_FOREVER);
        float temp = sensor_data_get_temp();
        snprintf(display_buffer, sizeof(display_buffer), "Temp: %.1f°C", temp);
        lcd_print(display_buffer);
        k_mutex_unlock(&lcd_mutex);
        
        k_sleep(K_SECONDS(1.5));
    }
}

static void humidity_display_thread(void *p1, void *p2, void *p3) {
    char display_buffer[32];
    
    while(1) {
        k_mutex_lock(&lcd_mutex, K_FOREVER);
        int humidity = sensor_data_get_humidity();
        snprintf(display_buffer, sizeof(display_buffer), "Vlažnost: %d%%", humidity);
        lcd_print(display_buffer);
        k_mutex_unlock(&lcd_mutex);
        
        k_sleep(K_SECONDS(2.5));
    }
}

static void status_display_thread(void *p1, void *p2, void *p3) {
    char display_buffer[32];
    
    while(1) {
        k_mutex_lock(&lcd_mutex, K_FOREVER);
        snprintf(display_buffer, sizeof(display_buffer), "Status: %s", get_system_status());
        lcd_print(display_buffer);
        k_mutex_unlock(&lcd_mutex);
        
        k_sleep(K_SECONDS(3.5));
    }
}

K_THREAD_DEFINE(temp_display_tid, LCD_STACK_SIZE, temperature_display_thread,
                NULL, NULL, NULL, LCD_PRIORITY, 0, 0);

K_THREAD_DEFINE(hum_display_tid, LCD_STACK_SIZE, humidity_display_thread,
                NULL, NULL, NULL, LCD_PRIORITY, 0, 0);

K_THREAD_DEFINE(status_display_tid, LCD_STACK_SIZE, status_display_thread,
                NULL, NULL, NULL, LCD_PRIORITY, 0, 0);

void mutex_lcd_init(void) {
    printk("MUTEX ZADATAK: Pokrenut\n");
}
```

## src/sem_sensor.c
```c
#include <zephyr/kernel.h>
#include <zephyr/sys/printk.h>
#include <zephyr/random/random.h>
#include "shared_data.h"

#define WORKER_STACK_SIZE 1024
#define WORKER_PRIORITY 6
#define HUMIDITY_SENSOR_PERIOD K_SECONDS(5)

K_SEM_DEFINE(data_available, 0, 1);

static struct {
    float temperature;
    k_spinlock_key_t key;
} sensor_buffer = {
    .temperature = 0.0f,
    .key = { 0 }
};

static struct k_spinlock data_lock;

/* Timer za simulaciju humidity senzora */
static void humidity_sensor_simulation(struct k_timer *timer) {
    static int humidity = 50;
    humidity += (sys_rand32_get() % 11 - 5);
    if(humidity < 30) humidity = 30;
    if(humidity > 80) humidity = 80;
    
    sensor_data_set_humidity(humidity);
    uint32_t uptime = k_uptime_get_32();
    printk("[%6d.%03d] [HUMIDITY-SENSOR] Nova vlažnost: %d%%\n", 
           uptime/1000, uptime%1000, humidity);
}

K_TIMER_DEFINE(humidity_timer, humidity_sensor_simulation, NULL);

static void sensor_isr_simulation(struct k_timer *timer) {
    k_spinlock_key_t key = k_spin_lock(&data_lock);
    sensor_buffer.temperature = 20.0f + (sys_rand32_get() % 150) * 0.1f;
    k_spin_unlock(&data_lock, key);
    
    uint32_t uptime = k_uptime_get_32();
    printk("[%6d.%03d] [SEMAFOR-ISR] Nova temperatura: %.1f°C - Signal poslat!\n", 
           uptime/1000, uptime%1000, sensor_buffer.temperature);
    k_sem_give(&data_available);
}

K_TIMER_DEFINE(sensor_timer, sensor_isr_simulation, NULL);

static void sensor_worker_thread(void *p1, void *p2, void *p3) {
    float local_temp;
    
    while(1) {
        k_sem_take(&data_available, K_FOREVER);
        
        k_spinlock_key_t key = k_spin_lock(&data_lock);
        local_temp = sensor_buffer.temperature;
        k_spin_unlock(&data_lock, key);
        
        /* Ažuriraj dijeljene podatke */
        sensor_data_set_temp(local_temp);
        
        k_sleep(K_MSEC(200));
        
        if(local_temp > 30.0f) {
            uint32_t uptime = k_uptime_get_32();
            printk("[%6d.%03d] [SEMAFOR-WORKER] >>> UPOZORENJE: Visoka temperatura: %.1f°C\n", 
                   uptime/1000, uptime%1000, local_temp);
        } else if(local_temp < 22.0f) {
            uint32_t uptime = k_uptime_get_32();
            printk("[%6d.%03d] [SEMAFOR-WORKER] >>> INFO: Niska temperatura: %.1f°C\n", 
                   uptime/1000, uptime%1000, local_temp);
        } else {
            uint32_t uptime = k_uptime_get_32();
            printk("[%6d.%03d] [SEMAFOR-WORKER] >>> INFO: Normalna temperatura: %.1f°C\n", 
                   uptime/1000, uptime%1000, local_temp);
        }
    }
}

K_THREAD_DEFINE(worker_tid, WORKER_STACK_SIZE, sensor_worker_thread,
                NULL, NULL, NULL, WORKER_PRIORITY, 0, 0);

void sem_sensor_init(void) {
    printk("SEMAFOR ZADATAK: Pokrenut\n");
    k_timer_start(&sensor_timer, K_MSEC(1000), K_MSEC(800));
    k_timer_start(&humidity_timer, K_SECONDS(2), HUMIDITY_SENSOR_PERIOD);
}
```

## src/shared_data.c
```c
#include "shared_data.h"

/* Definicija dijeljenih podataka */
struct sensor_data shared_sensors;

void sensor_data_init(void) {
    k_mutex_init(&shared_sensors.lock);
    shared_sensors.temperature = 25.0f;
    shared_sensors.humidity = 50;
}

void sensor_data_set_temp(float temp) {
    k_mutex_lock(&shared_sensors.lock, K_FOREVER);
    shared_sensors.temperature = temp;
    k_mutex_unlock(&shared_sensors.lock);
}

void sensor_data_set_humidity(int humidity) {
    k_mutex_lock(&shared_sensors.lock, K_FOREVER);
    shared_sensors.humidity = humidity;
    k_mutex_unlock(&shared_sensors.lock);
}

float sensor_data_get_temp(void) {
    float temp;
    k_mutex_lock(&shared_sensors.lock, K_FOREVER);
    temp = shared_sensors.temperature;
    k_mutex_unlock(&shared_sensors.lock);
    return temp;
}

int sensor_data_get_humidity(void) {
    int humidity;
    k_mutex_lock(&shared_sensors.lock, K_FOREVER);
    humidity = shared_sensors.humidity;
    k_mutex_unlock(&shared_sensors.lock);
    return humidity;
}
```

## src/shared_data.h
```c
#ifndef SHARED_DATA_H
#define SHARED_DATA_H

#include <zephyr/kernel.h>

/* Struktura za dijeljene senzorske podatke */
struct sensor_data {
    float temperature;
    int humidity;
    struct k_mutex lock;
};

/* Globalna varijabla dostupna svim modulima */
extern struct sensor_data shared_sensors;

/* Funkcije za siguran pristup podacima */
void sensor_data_init(void);
void sensor_data_set_temp(float temp);
void sensor_data_set_humidity(int humidity);
float sensor_data_get_temp(void);
int sensor_data_get_humidity(void);

#endif
```
