## CMakeLists.txt
```
cmake_minimum_required(VERSION 3.20.0)
find_package(Zephyr REQUIRED HINTS $ENV{ZEPHYR_BASE})
project(task_communication_demo)

target_sources(app PRIVATE
    src/main.c
    src/queue_demo.c
    src/pipe_demo.c
)
```

## prj.conf
```kconfig
# Zajednička konfiguracija za Queue i Pipe demonstracije

# ========== OSNOVNA KONFIGURACIJA ==========
# Console output
CONFIG_PRINTK=y
CONFIG_STDOUT_CONSOLE=y

# Main thread
CONFIG_MAIN_THREAD_PRIORITY=10
CONFIG_MAIN_STACK_SIZE=2048

# ========== KERNEL FEATURES ==========
# Thread naming za lakše praćenje
CONFIG_THREAD_NAME=y
CONFIG_THREAD_MONITOR=y

# Stack usage monitoring
CONFIG_THREAD_STACK_INFO=y
CONFIG_INIT_STACKS=y

# ========== IPC KONFIGURACIJA ==========
# Eksplicitno omogući pipes
CONFIG_PIPES=y

# ========== HEAP KONFIGURACIJA ==========
# Povećan system heap za dinamičke alokacije
CONFIG_HEAP_MEM_POOL_SIZE=4096

# ========== TIMING KONFIGURACIJA ==========
# Preciznije timing informacije
CONFIG_SYS_CLOCK_TICKS_PER_SEC=1000

# ========== DEBUG OPCIJE ==========
# Object tracking
CONFIG_TRACING=n  # Postaviti na 'y' za debug
CONFIG_OBJECT_TRACING=n

# Thread runtime statistics
CONFIG_THREAD_RUNTIME_STATS=n  # Postaviti na 'y' za analizu

# ========== OPCIONE FUNKCIONALNOSTI ==========
# Omogući stream mode za pipe demo
# CONFIG_PIPE_STREAM_MODE=y

# ========== ASSERT I ERROR CHECKING ==========
CONFIG_ASSERT=y
CONFIG_ASSERT_LEVEL=2

# ========== LOGGING (OPCIONO) ==========
# CONFIG_LOG=y
# CONFIG_LOG_DEFAULT_LEVEL=3
# CONFIG_LOG_MODE_IMMEDIATE=y

# ========== SHELL PODRŠKA (OPCIONO) ==========
# Za interaktivno testiranje
# CONFIG_SHELL=y
# CONFIG_KERNEL_SHELL=y
# CONFIG_DEVICE_SHELL=y
# CONFIG_THREAD_MONITOR_SHELL=y
```

## src/main.c
```c
#include <zephyr/kernel.h>
#include <zephyr/sys/printk.h>

extern void queue_demo_init(void);
extern void pipe_demo_init(void);
extern void queue_demo_stop(void);
extern void pipe_demo_stop(void);

/* Dužina trajanja svake demonstracije */
#define DEMO_DURATION_SEC    30  /* 30 sekundi po demonstraciji */

/* Thread za pokretanje demo-a */
K_THREAD_STACK_DEFINE(demo_stack, 2048);
struct k_thread demo_thread;

/* Funkcija koja pokreće demo u zasebnom thread-u */
void demo_runner(void *init_func, void *stop_func, void *unused)
{
    void (*init)(void) = init_func;
    init();
}

void run_demo_with_timer(const char *demo_name, void (*init_func)(void), void (*stop_func)(void))
{
    /* Kreiranje thread za demo */
    k_tid_t tid = k_thread_create(&demo_thread, demo_stack,
                                  K_THREAD_STACK_SIZEOF(demo_stack),
                                  demo_runner, init_func, stop_func, NULL,
                                  4, 0, K_NO_WAIT);
    
    /* Čekanje dok demo traje */
    k_msleep(DEMO_DURATION_SEC * 1000);
    
    /* Zaustavljanje*/
    stop_func();
    k_thread_join(&demo_thread, K_SECONDS(5));
    
    /* Pauza između demonstracija */
    k_msleep(3000);
}

void main(void)
{
    printk("\n=== Zephyr IPC Demo ===\n");
    printk("Task1: 3s period | Task2: 7s period\n");
    printk("Trajanje: %d sekundi po demo\n", DEMO_DURATION_SEC);
    
    /* Pauza za stabilizaciju sistema */
    k_msleep(1000);
    
    /* Pokretanje Message Queue Demo */
    run_demo_with_timer("Message Queue", queue_demo_init, queue_demo_stop);
    
    /* Pokretanje Pipe Demo */
    run_demo_with_timer("Pipe", pipe_demo_init, pipe_demo_stop);
    
    printk("\n=== DEMO ZAVRŠEN ===\n");
    
    /* Main thread ostaje živ ali idle */
    while (1) {
        k_msleep(60000);
    }
}
```

## src/pipe_demo.c
```c
#include <zephyr/kernel.h>
#include <zephyr/sys/printk.h>
#include <string.h>

/* Pipe definicija - buffer od 256 bajtova */
K_PIPE_DEFINE(counter_pipe, 256, 4);

/* Stack definicije za pipe demo taskove */
K_THREAD_STACK_DEFINE(pipe_task1_stack, 1024);
K_THREAD_STACK_DEFINE(pipe_task2_stack, 1024);

/* Thread strukture */
static struct k_thread pipe_task1_thread;
static struct k_thread pipe_task2_thread;

/* Kontrolna promenljiva za zaustavljanje threadova */
static volatile bool pipe_demo_running = false;

/* Struktura za prenos podataka */
struct pipe_message {
    uint32_t counter;
    uint32_t timestamp;
} __packed;

/* Statistike za pipe demo */
static struct {
    uint32_t messages_sent;
    uint32_t messages_received;
    uint32_t partial_transfers;
} pipe_stats = {0};

/* Helper funkcija za formatiranje vremena */
static void print_time(void)
{
    uint32_t ms = k_uptime_get_32();
    printk("[%3u.%03u s] ", ms / 1000, ms % 1000);
}

/* Task 1: Producer - šalje strukturirane podatke svake 3 sekunde */
static void pipe_producer_task(void *p1, void *p2, void *p3)
{
    struct pipe_message msg;
    size_t bytes_written;
    uint32_t counter = 0;
    int ret;
    
    print_time();
    printk("Pipe Task1 pokrenut\n");
    
    while (pipe_demo_running) {
        counter++;
        
        /* Pripremi poruku */
        msg.counter = counter;
        msg.timestamp = k_uptime_get_32();
        
        /* Pošalji kroz pipe */
        ret = k_pipe_put(&counter_pipe, &msg, sizeof(msg), 
                        &bytes_written, sizeof(msg), K_MSEC(100));
        
        if (ret == 0 && bytes_written == sizeof(msg)) {
            pipe_stats.messages_sent++;
            print_time();
            printk("Task1 šalje: %u\n", counter);
        } else if (ret == 0 && bytes_written < sizeof(msg)) {
            pipe_stats.partial_transfers++;
            print_time();
            printk("Task1 PARTIAL: %u (samo %zu/%zu bajtova)\n", 
                   counter, bytes_written, sizeof(msg));
        } else {
            print_time();
            printk("Task1 FAILED: %u\n", counter);
        }
        
        /* Proveri da li treba stati pre čekanja */
        for (int i = 0; i < 30 && pipe_demo_running; i++) {
            k_msleep(100);
        }
    }
}

/* Task 2: Consumer - čita strukturirane podatke svake 7 sekunde */
static void pipe_consumer_task(void *p1, void *p2, void *p3)
{
    struct pipe_message msg;
    size_t bytes_read;
    int ret;
    int count;
    
    print_time();
    printk("Pipe Task2 pokrenut\n");
    
    while (pipe_demo_running) {
        /* Čekanje u manjim intervalima za brži prekid */
        for (int i = 0; i < 70 && pipe_demo_running; i++) {
            k_msleep(100);
        }
        
        if (!pipe_demo_running) break;
        
        count = 0;
        print_time();
        printk("Task2 čita: ");
        
        /* Čitaj sve dostupne kompletne poruke */
        while (1) {
            ret = k_pipe_get(&counter_pipe, &msg, sizeof(msg),
                            &bytes_read, sizeof(msg), K_NO_WAIT);
            
            if (ret != 0 || bytes_read < sizeof(msg)) {
                break;
            }
            
            if (count > 0) printk(", ");
            printk("%u", msg.counter);
            count++;
            pipe_stats.messages_received++;
        }
        
        if (count == 0) {
            printk("(prazno)");
        }
        printk(" [ukupno: %d]\n", count);
    }
}

/* Javna funkcija za inicijalizaciju pipe demo */
void pipe_demo_init(void)
{
    printk("\n--- PIPE DEMO ---\n");
    
    /* Resetuj statistike */
    memset(&pipe_stats, 0, sizeof(pipe_stats));
    
    /* Isprazni pipe */
    k_pipe_flush(&counter_pipe);
    
    pipe_demo_running = true;
    
    /* Kreiraj producer task */
    k_thread_create(&pipe_task1_thread, pipe_task1_stack,
                    K_THREAD_STACK_SIZEOF(pipe_task1_stack),
                    pipe_producer_task, NULL, NULL, NULL,
                    5, 0, K_NO_WAIT);
    k_thread_name_set(&pipe_task1_thread, "pipe_producer");
    
    /* Kreiraj consumer task */
    k_thread_create(&pipe_task2_thread, pipe_task2_stack,
                    K_THREAD_STACK_SIZEOF(pipe_task2_stack),
                    pipe_consumer_task, NULL, NULL, NULL,
                    5, 0, K_NO_WAIT);
    k_thread_name_set(&pipe_task2_thread, "pipe_consumer");
    
    /* Čekaj da se demo završi (poziva se iz main-a) */
    while (pipe_demo_running) {
        k_msleep(1000);
    }
    
    /* Sačekaj da se threadovi završe */
    k_thread_join(&pipe_task1_thread, K_SECONDS(2));
    k_thread_join(&pipe_task2_thread, K_SECONDS(2));
    
    /* Prikaži finalne statistike */
    print_time();
    printk("Pipe rezultat: poslano=%u, primljeno=%u, parcijalno=%u\n",
           pipe_stats.messages_sent,
           pipe_stats.messages_received,
           pipe_stats.partial_transfers);
}

/* Javna funkcija za zaustavljanje demo-a */
void pipe_demo_stop(void)
{
    pipe_demo_running = false;
}
```

## src/queue_demo.c
```c
#include <zephyr/kernel.h>
#include <zephyr/sys/printk.h>

/* Message Queue definicija - kapacitet 10 poruka */
K_MSGQ_DEFINE(counter_msgq, sizeof(uint32_t), 10, 4);

/* Stack definicije za queue demo taskove */
K_THREAD_STACK_DEFINE(queue_task1_stack, 1024);
K_THREAD_STACK_DEFINE(queue_task2_stack, 1024);

/* Thread strukture */
static struct k_thread queue_task1_thread;
static struct k_thread queue_task2_thread;

/* Kontrolna promenljiva za zaustavljanje threadova */
static volatile bool queue_demo_running = false;

/* Statistike za queue demo */
static struct {
    uint32_t messages_sent;
    uint32_t messages_received;
    uint32_t messages_dropped;
    uint32_t max_queue_usage;
} queue_stats = {0};

/* Helper funkcija za formatiranje vremena */
static void print_time(void)
{
    uint32_t ms = k_uptime_get_32();
    printk("[%3u.%03u s] ", ms / 1000, ms % 1000);
}

/* Task 1: Producer - šalje brojač svake 3 sekunde */
static void queue_producer_task(void *p1, void *p2, void *p3)
{
    uint32_t counter = 0;
    int ret;
    
    print_time();
    printk("MsgQueue Task1 pokrenut\n");
    
    while (queue_demo_running) {
        counter++;
        
        /* Pokušaj slanja */
        ret = k_msgq_put(&counter_msgq, &counter, K_NO_WAIT);
        
        if (ret == 0) {
            queue_stats.messages_sent++;
            print_time();
            printk("Task1 šalje: %u\n", counter);
            
            /* Ažuriraj max queue usage */
            uint32_t used = k_msgq_num_used_get(&counter_msgq);
            if (used > queue_stats.max_queue_usage) {
                queue_stats.max_queue_usage = used;
            }
        } else {
            queue_stats.messages_dropped++;
            print_time();
            printk("Task1 DROPPED: %u (queue full)\n", counter);
        }
        
        /* Proveri da li treba stati pre čekanja */
        for (int i = 0; i < 30 && queue_demo_running; i++) {
            k_msleep(100);  /* Sleep u manjim intervalima */
        }
    }
}

/* Task 2: Consumer - čita brojače svake 7 sekunde */
static void queue_consumer_task(void *p1, void *p2, void *p3)
{
    uint32_t received_counter;
    int ret;
    int count = 0;
    
    print_time();
    printk("MsgQueue Task2 pokrenut\n");
    
    while (queue_demo_running) {
        /* Čekanje u manjim intervalima za brži prekid */
        for (int i = 0; i < 70 && queue_demo_running; i++) {
            k_msleep(100);
        }
        
        if (!queue_demo_running) break;
        
        count = 0;
        print_time();
        printk("Task2 čita: ");
        
        /* Čitaj sve dostupne poruke */
        while (1) {
            ret = k_msgq_get(&counter_msgq, &received_counter, K_NO_WAIT);
            
            if (ret != 0) {
                break;  /* Nema više poruka */
            }
            
            if (count > 0) printk(", ");
            printk("%u", received_counter);
            count++;
            queue_stats.messages_received++;
        }
        
        if (count == 0) {
            printk("(prazno)");
        }
        printk(" [ukupno: %d]\n", count);
    }
}

/* Javna funkcija za inicijalizaciju queue demo */
void queue_demo_init(void)
{
    printk("\n--- MESSAGE QUEUE DEMO ---\n");
    
    /* Resetuj statistike */
    memset(&queue_stats, 0, sizeof(queue_stats));
    
    /* Isprazni queue */
    k_msgq_purge(&counter_msgq);
    
    /* Postavi flag da demo radi */
    queue_demo_running = true;
    
    /* Kreiraj producer task */
    k_thread_create(&queue_task1_thread, queue_task1_stack,
                    K_THREAD_STACK_SIZEOF(queue_task1_stack),
                    queue_producer_task, NULL, NULL, NULL,
                    5, 0, K_NO_WAIT);
    k_thread_name_set(&queue_task1_thread, "queue_producer");
    
    /* Kreiraj consumer task */
    k_thread_create(&queue_task2_thread, queue_task2_stack,
                    K_THREAD_STACK_SIZEOF(queue_task2_stack),
                    queue_consumer_task, NULL, NULL, NULL,
                    5, 0, K_NO_WAIT);
    k_thread_name_set(&queue_task2_thread, "queue_consumer");
    
    /* Čekaj da se demo završi (poziva se iz main-a) */
    while (queue_demo_running) {
        k_msleep(1000);
    }
    
    /* Sačekaj da se threadovi završe */
    k_thread_join(&queue_task1_thread, K_SECONDS(2));
    k_thread_join(&queue_task2_thread, K_SECONDS(2));
    
    /* Prikaži finalne statistike */
    print_time();
    printk("MsgQueue rezultat: poslano=%u, primljeno=%u, izgubljeno=%u\n",
           queue_stats.messages_sent,
           queue_stats.messages_received,
           queue_stats.messages_dropped);
}

/* Javna funkcija za zaustavljanje demo-a */
void queue_demo_stop(void)
{
    queue_demo_running = false;
}
```
