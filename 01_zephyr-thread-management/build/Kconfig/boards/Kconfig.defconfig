## 01_zephyr-thread-management/build/Kconfig/boards/Kconfig.defconfig
```kconfig
# Load Zephyr board defconfig descriptions.
osource "/home/emina/zephyrproject/zephyr/boards/qemu/cortex_a53/Kconfig.defconfig"
```

## 03_zephyr-thread-synchronization/build/Kconfig/boards/Kconfig
```kconfig
# Load Zephyr board Kconfig descriptions.
osource "/home/emina/zephyrproject/zephyr/boards/qemu/cortex_a53/Kconfig"
```

## 03_zephyr-thread-synchronization/build/Kconfig/boards/Kconfig.qemu_cortex_a53
```kconfig
# Load board Kconfig descriptions.
osource "/home/emina/zephyrproject/zephyr/boards/qemu/cortex_a53/Kconfig.qemu_cortex_a53"
```

## 04_zephyr-timers/build/Kconfig/arch/Kconfig
```kconfig
# Load Zephyr Arch Kconfig descriptions.
osource "/home/emina/zephyrproject/zephyr/arch/rx/Kconfig"
osource "/home/emina/zephyrproject/zephyr/arch/x86/Kconfig"
osource "/home/emina/zephyrproject/zephyr/arch/xtensa/Kconfig"
osource "/home/emina/zephyrproject/zephyr/arch/sparc/Kconfig"
osource "/home/emina/zephyrproject/zephyr/arch/riscv/Kconfig"
osource "/home/emina/zephyrproject/zephyr/arch/posix/Kconfig"
osource "/home/emina/zephyrproject/zephyr/arch/mips/Kconfig"
osource "/home/emina/zephyrproject/zephyr/arch/arm64/Kconfig"
osource "/home/emina/zephyrproject/zephyr/arch/arm/Kconfig"
osource "/home/emina/zephyrproject/zephyr/arch/arc/Kconfig"
```

## 04_zephyr-timers/build/Kconfig/boards/Kconfig
```kconfig
# Load Zephyr board Kconfig descriptions.
osource "/home/emina/zephyrproject/zephyr/boards/raspberrypi/rpi_4b/Kconfig"
```

## 04_zephyr-timers/build/Kconfig/boards/Kconfig.defconfig
```kconfig
# Load Zephyr board defconfig descriptions.
osource "/home/emina/zephyrproject/zephyr/boards/raspberrypi/rpi_4b/Kconfig.defconfig"
```

## 04_zephyr-timers/build/Kconfig/boards/Kconfig.rpi_4b
```kconfig
# Load board Kconfig descriptions.
osource "/home/emina/zephyrproject/zephyr/boards/raspberrypi/rpi_4b/Kconfig.rpi_4b"
```

## 04_zephyr-timers/build/Kconfig/boards/Kconfig.sysbuild
```kconfig
# Load Sysbuild board Kconfig descriptions.
osource "/home/emina/zephyrproject/zephyr/boards/raspberrypi/rpi_4b/Kconfig.sysbuild"
```
