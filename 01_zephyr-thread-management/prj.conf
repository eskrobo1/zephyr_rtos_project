## CMakeLists.txt
```
cmake_minimum_required(VERSION 3.20.0)
find_package(Zephyr REQUIRED HINTS $ENV{ZEPHYR_BASE})
project(task_management_demo)

target_sources(app PRIVATE
    src/main.c
    src/static_dinamic_threads.c
    src/scheduling_tests.c
)
```

## prj.conf
```kconfig
# Console i debugging
CONFIG_SERIAL=y
CONFIG_CONSOLE=y
CONFIG_UART_CONSOLE=y
CONFIG_PRINTK=y

# Thread stack sizes
CONFIG_MAIN_STACK_SIZE=2048
CONFIG_IDLE_STACK_SIZE=512
CONFIG_ISR_STACK_SIZE=2048

# Heap za dinamičke taskove
CONFIG_HEAP_MEM_POOL_SIZE=16384

# TIMING CONFIGURATION - VAŽNO!
CONFIG_SYS_CLOCK_TICKS_PER_SEC=1000
CONFIG_SYS_CLOCK_EXISTS=y
CONFIG_TIMEOUT_64BIT=y

# Thread features
CONFIG_THREAD_NAME=y
CONFIG_THREAD_MONITOR=y

# ZA TEST SA TIME SLICING:
CONFIG_TIMESLICING=n
```

## src/main.c
```c
#include <zephyr/kernel.h>
#include <zephyr/sys/printk.h>

/* Deklaracije za statičke niti */
void stop_static_threads(void);

/* Deklaracije za dinamičke niti */
void create_dynamic_threads(void);
void stop_dynamic_threads(void);
void scheduling_tests_init(void);

int main(void)
{
    printk("\n================================================\n");
    printk("=== Zephyr Task Management Demo ===\n");
    printk("================================================\n");
    printk("Ploca: %s\n", CONFIG_BOARD);
    printk("Frekvencija sistema: %d Hz\n", CONFIG_SYS_CLOCK_TICKS_PER_SEC);
    
    /* Demonstracija osnovnih taskova */
    printk("\n--- Testiranje statičkih i dinamičkih niti ---\n");
    printk("\n--- STATIČKE NITI ---\n");
    /* Statičke niti su već pokrenute automatski putem K_THREAD_DEFINE */
    k_sleep(K_SECONDS(15));
    stop_static_threads();
    
    printk("\n--- DINAMIČKE NITI ---\n");
    create_dynamic_threads();
    k_sleep(K_SECONDS(15));
    stop_dynamic_threads();
    
    /* Demonstracija scheduling politika */
    printk("\n--- Demonstracija scheduling politika ---\n");
    scheduling_tests_init();
    
    printk("\n=== Gotovi svi testovi ===\n");
    
    /* Nastavi izvršavanje osnovnih taskova */
    while (1) {
        k_sleep(K_SECONDS(10));
    }
    
    return 0;
}

/* Pomoćna funkcija za ispis vremena */
void print_timing_info(const char *task_name, uint32_t expected_ms, uint32_t actual_ms)
{
    int32_t deviation = actual_ms - expected_ms;
    int percent = (deviation * 100) / expected_ms;
    
    if (abs(percent) < 5) {
        printk("[TAJMING] %s: Ocekivano %u ms, Stvarno %u ms - OK (odstupanje: %d%%)\n",
               task_name, expected_ms, actual_ms, percent);
    } else {
        printk("[TAJMING] %s: Ocekivano %u ms, Stvarno %u ms - UPOZORENJE (odstupanje: %d%%)\n",
               task_name, expected_ms, actual_ms, percent);
    }
}
```

## src/scheduling_tests.c
```c
#include <zephyr/kernel.h>
#include <zephyr/sys/printk.h>

/* Stack za test taskove */
K_THREAD_STACK_DEFINE(test1_stack, 1024);
K_THREAD_STACK_DEFINE(test2_stack, 1024);
static struct k_thread test1_data;
static struct k_thread test2_data;

static volatile bool test_running = true;
static volatile int shared_counter = 0;

/* Test task koji ne prepušta kontrolu */
void blocking_task(void *p1, void *p2, void *p3)
{
    int task_id = POINTER_TO_INT(p1);
    ARG_UNUSED(p2);
    ARG_UNUSED(p3);
    
    printk("[TEST BLOKIRANJA] Task %d pokrenut\n", task_id);
    
    for (int i = 0; i < 3 && test_running; i++) {
        int64_t start = k_uptime_get();
        
        /* Busy wait 1s - simulacija blokiranja */
        while ((k_uptime_get() - start) < 1000) {
            shared_counter++;
        }
        
        printk("[%3lld s] Blokirajuci Task %d - iteracija %d, brojac=%d\n", 
               k_uptime_get() / 1000, task_id, i+1, shared_counter);
    }
    
    printk("[TEST BLOKIRANJA] Task %d zavrsen\n", task_id);
}

/* Test za preemptivno raspoređivanje */
void test_preemption(void)
{
    printk("\n=== TEST: PREEMPTIVNO RASPOREDIVANJE ===\n");
    printk("Kreiranje 2 taska sa istim POZITIVNIM prioritetom (preemptivno)...\n");
    printk("Konfiguracija: CONFIG_TIMESLICING=%s\n", 
           IS_ENABLED(CONFIG_TIMESLICING) ? "omogućeno" : "onemogućeno");
    
    shared_counter = 0;
    test_running = true;
    
    k_thread_create(&test1_data, test1_stack,
                    K_THREAD_STACK_SIZEOF(test1_stack),
                    blocking_task, INT_TO_POINTER(1), NULL, NULL,
                    7, 0, K_NO_WAIT);  // Pozitivni prioritet = preemptivno
    
    k_thread_create(&test2_data, test2_stack,
                    K_THREAD_STACK_SIZEOF(test2_stack),
                    blocking_task, INT_TO_POINTER(2), NULL, NULL,
                    7, 0, K_NO_WAIT);  // Pozitivni prioritet = preemptivno
    
    k_sleep(K_SECONDS(6));
    test_running = false;
    k_sleep(K_MSEC(100));
    
    printk("Test zavrsen. Finalni brojac: %d\n", shared_counter);
    printk("=========================================\n\n");
}

/* Test za cooperativno raspoređivanje */
void test_cooperative(void)
{
    printk("\n=== TEST: COOPERATIVNO RASPOREDIVANJE ===\n");
    printk("Kreiranje 2 taska sa istim NEGATIVNIM prioritetom (cooperativno)...\n");
    
    shared_counter = 0;
    test_running = true;
    
    k_thread_create(&test1_data, test1_stack,
                    K_THREAD_STACK_SIZEOF(test1_stack),
                    blocking_task, INT_TO_POINTER(1), NULL, NULL,
                    -7, 0, K_NO_WAIT);  // Negativni prioritet = cooperativno
    
    k_thread_create(&test2_data, test2_stack,
                    K_THREAD_STACK_SIZEOF(test2_stack),
                    blocking_task, INT_TO_POINTER(2), NULL, NULL,
                    -7, 0, K_NO_WAIT);  // Negativni prioritet = cooperativno
    
    k_sleep(K_SECONDS(6));
    test_running = false;
    k_sleep(K_MSEC(100));
    
    printk("Test zavrsen. Finalni brojac: %d\n", shared_counter);
    printk("=========================================\n\n");
}

/* Test za prioritete */
void priority_task(void *p1, void *p2, void *p3)
{
    int task_id = POINTER_TO_INT(p1);
    int priority = POINTER_TO_INT(p2);
    ARG_UNUSED(p3);
    
    for (int i = 0; i < 3; i++) {
        printk("[%3lld s] Prioritetni Task %d (prio=%d) - izvrsavanje %d\n", 
               k_uptime_get() / 1000, task_id, priority, i+1);
        k_sleep(K_SECONDS(1));
    }
}

void test_priorities_preemptive(void)
{
    printk("\n=== TEST: PREEMPTIVNI PRIORITETI ===\n");
    printk("Task 1: prioritet 5 (viši), Task 2: prioritet 10 (niži)\n");
    
    k_tid_t tid1 = k_thread_create(&test1_data, test1_stack,
                    K_THREAD_STACK_SIZEOF(test1_stack),
                    priority_task, INT_TO_POINTER(1), INT_TO_POINTER(5), NULL,
                    5, 0, K_FOREVER);  // Pozitivni = preemptivni
    
    k_tid_t tid2 = k_thread_create(&test2_data, test2_stack,
                    K_THREAD_STACK_SIZEOF(test2_stack),
                    priority_task, INT_TO_POINTER(2), INT_TO_POINTER(10), NULL,
                    10, 0, K_FOREVER);  // Pozitivni = preemptivni
    
    k_thread_start(tid1);
    k_thread_start(tid2);
    
    k_sleep(K_SECONDS(4));
    
    printk("==========================================\n\n");
}

void test_priorities_cooperative(void)
{
    printk("\n=== TEST: COOPERATIVNI PRIORITETI ===\n");
    printk("Task 1: prioritet -5 (niži), Task 2: prioritet -10 (viši)\n");
    
    k_tid_t tid1 = k_thread_create(&test1_data, test1_stack,
                    K_THREAD_STACK_SIZEOF(test1_stack),
                    priority_task, INT_TO_POINTER(1), INT_TO_POINTER(-5), NULL,
                    -5, 0, K_FOREVER);  // Negativni = cooperativni
    
    k_tid_t tid2 = k_thread_create(&test2_data, test2_stack,
                    K_THREAD_STACK_SIZEOF(test2_stack),
                    priority_task, INT_TO_POINTER(2), INT_TO_POINTER(-10), NULL,
                    -10, 0, K_FOREVER);  // Negativni = cooperativni
    
    k_thread_start(tid1);
    k_thread_start(tid2);
    
    k_sleep(K_SECONDS(4));
    
    printk("==========================================\n\n");
}

void scheduling_tests_init(void)
{
    printk("\n=== ZEPHYR SCHEDULING TESTS ===\n");
    printk("CONFIG_TIMESLICING: %s\n", 
           IS_ENABLED(CONFIG_TIMESLICING) ? "DA" : "NE");
    printk("===============================\n");
    
    test_preemption();        // Pozitivni prioriteti + busy wait
    test_cooperative();       // Negativni prioriteti + busy wait  
    test_priorities_preemptive();   // Različiti pozitivni prioriteti
    test_priorities_cooperative();  // Različiti negativni prioriteti
}
```

## src/static_dinamic_threads.c
```c
#include <zephyr/kernel.h>
#include <zephyr/sys/printk.h>

/* Eksterna funkcija za ispis timing informacija */
extern void print_timing_info(const char *thread_name, uint32_t expected_ms, uint32_t actual_ms);


#define STATIC_STACK_SIZE 1024
#define STATIC_PRIORITY 5

static volatile bool static_threads_running = true;
static uint32_t static_thread1_count = 0;
static uint32_t static_thread2_count = 0;
static int64_t static_thread1_last_execution = 0;
static int64_t static_thread2_last_execution = 0;

/* Statička nit 1 - Period 3 sekunde */
void static_thread1_entry(void)
{   
    printk("[STATIČKA NIT 1] Početak izvršavanja - period 3s\n");
    
    while (static_threads_running) {
        int64_t start_time = k_uptime_get();
        
        /* Prikaz vremena u sekundama */
        printk("[%3lld s] Statička Nit 1 - izvršavanje #%u\n", 
               start_time / 1000, ++static_thread1_count);
        
        /* Provjera perioda svako 5. izvršavanje */
        if (static_thread1_last_execution != 0 && static_thread1_count % 5 == 0) {
            uint32_t actual_period = start_time - static_thread1_last_execution;
            print_timing_info("Statička Nit 1", 3000, actual_period); 
        }
        static_thread1_last_execution = start_time;
        
        k_sleep(K_SECONDS(3));
    }
    printk("[STATIČKA NIT 1] Završava izvršavanje\n");
}

/* Statička nit 2 - Period 7 sekundi */
void static_thread2_entry(void)
{
    printk("[STATIČKA NIT 2] Početak izvršavanja - period 7s\n");
    
    while (static_threads_running) {
        int64_t start_time = k_uptime_get();
        
        printk("[%3lld s] Statička Nit 2 - izvršavanje #%u\n", 
               start_time / 1000, ++static_thread2_count);
        
        /* Provjera perioda svako 3. izvršavanje */
        if (static_thread2_last_execution != 0 && static_thread2_count % 3 == 0) {
            uint32_t actual_period = start_time - static_thread2_last_execution;
            print_timing_info("Statička Nit 2", 7000, actual_period); 
        }
        static_thread2_last_execution = start_time;
        
        k_sleep(K_SECONDS(7));
    }
    printk("[STATIČKA NIT 2] Završava izvršavanje\n");
}

/* DEFINISANJE STATIČKIH NITI - sve se kreira automatski */
K_THREAD_DEFINE(static_thread1_id, STATIC_STACK_SIZE,
                static_thread1_entry, NULL, NULL, NULL,
                STATIC_PRIORITY, 0, 0);

K_THREAD_DEFINE(static_thread2_id, STATIC_STACK_SIZE,
                static_thread2_entry, NULL, NULL, NULL,
                STATIC_PRIORITY, 0, 0);

/* Funkcija za zaustavljanje statičkih niti */
void stop_static_threads(void)
{
    static_threads_running = false;
    
    // Čekamo da se niti završe
    k_thread_join(static_thread1_id, K_SECONDS(5));
    k_thread_join(static_thread2_id, K_SECONDS(5));
    
    printk("Statičke niti su zaustavljene\n");
}


#define DYNAMIC_STACK_SIZE 1024
#define DYNAMIC_PRIORITY 6

/* Stack definicije za dinamičke niti */
K_THREAD_STACK_DEFINE(dynamic_thread1_stack, DYNAMIC_STACK_SIZE);
K_THREAD_STACK_DEFINE(dynamic_thread2_stack, DYNAMIC_STACK_SIZE);

/* Thread kontrolni blokovi */
static struct k_thread dynamic_thread1_data;
static struct k_thread dynamic_thread2_data;

static k_tid_t dynamic_thread1_tid;
static k_tid_t dynamic_thread2_tid;

static volatile bool dynamic_threads_running = false;
static uint32_t dynamic_thread1_count = 0;
static uint32_t dynamic_thread2_count = 0;
static int64_t dynamic_thread1_last_execution = 0;
static int64_t dynamic_thread2_last_execution = 0;

/* Dinamička nit 1 - Period 2 sekunde */
void dynamic_thread1_entry(void)
{   
    printk("[DINAMIČKA NIT 1] Početak izvršavanja - period 3s\n");
    
    while (dynamic_threads_running) {
        int64_t start_time = k_uptime_get();
        
        /* Prikaz vremena u sekundama */
        printk("[%3lld s] Dinamička Nit 1 - izvršavanje #%u\n", 
               start_time / 1000, ++dynamic_thread1_count);
        
        /* Provjera perioda svako 5. izvršavanje */
        if (dynamic_thread1_last_execution != 0 && dynamic_thread1_count % 5 == 0) {
            uint32_t actual_period = start_time - dynamic_thread1_last_execution;
            print_timing_info("Dinamička Nit 1", 3000, actual_period); 
        }
        dynamic_thread1_last_execution = start_time;
        
        k_sleep(K_SECONDS(3));
    }
    printk("[DINAMIČKA NIT 1] Završava izvršavanje\n");
}

/* Dinamička nit 2 - Period 5 sekundi */
void dynamic_thread2_entry(void)
{
    printk("[DINAMIČKA NIT 2] Početak izvršavanja - period 7s\n");
    
    while (dynamic_threads_running) {
        int64_t start_time = k_uptime_get();
        
        printk("[%3lld s] Dinamička Nit 2 - izvršavanje #%u\n", 
               start_time / 1000, ++dynamic_thread2_count);
        
        /* Provjera perioda svako 3. izvršavanje */
        if (dynamic_thread2_last_execution != 0 && dynamic_thread2_count % 3 == 0) {
            uint32_t actual_period = start_time - dynamic_thread2_last_execution;
            print_timing_info("Dinamička Nit 2", 7000, actual_period); 
        }
        dynamic_thread2_last_execution = start_time;
        
        k_sleep(K_SECONDS(7));
    }
    printk("[DINAMIČKA NIT 2] Završava izvršavanje\n");
}

/* Kreiranje dinamičkih niti */
void create_dynamic_threads(void)
{
    
    dynamic_threads_running = true;
    
    /* Reset brojača prije kreiranja */
    dynamic_thread1_count = 0;
    dynamic_thread2_count = 0;
    dynamic_thread1_last_execution = 0;
    dynamic_thread2_last_execution = 0;
    
    dynamic_thread1_tid = k_thread_create(&dynamic_thread1_data, 
                                         dynamic_thread1_stack,
                                         K_THREAD_STACK_SIZEOF(dynamic_thread1_stack),
                                         dynamic_thread1_entry, 
                                         NULL, NULL, NULL,
                                         DYNAMIC_PRIORITY, 0, K_NO_WAIT);
    
    dynamic_thread2_tid = k_thread_create(&dynamic_thread2_data, 
                                         dynamic_thread2_stack,
                                         K_THREAD_STACK_SIZEOF(dynamic_thread2_stack),
                                         dynamic_thread2_entry, 
                                         NULL, NULL, NULL,
                                         DYNAMIC_PRIORITY, 0, K_NO_WAIT);
}

void stop_dynamic_threads(void)
{
    dynamic_threads_running = false;
    
    k_thread_join(dynamic_thread1_tid, K_SECONDS(5));
    k_thread_join(dynamic_thread2_tid, K_SECONDS(5));
    
    printk("Dinamičke niti su zaustavljene\n");
}
```
